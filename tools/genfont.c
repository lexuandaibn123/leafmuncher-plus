/* genfont.c — sinh Core/Src/font8x16.c từ glyph ASCII-art.
 * Chạy trên HOST (mingw gcc), KHÔNG biên dịch vào firmware.
 *   gcc tools/genfont.c -o genfont && ./genfont > Core/Src/font8x16.c
 * Mỗi glyph = 16 hàng × 8 cột; '#' = bật, ký tự khác = tắt. MSB = cột trái (x=0).
 * Ký tự không khai báo → trống. gfx_text gộp chữ thường về hoa nên chỉ cần A–Z. */

#include <stdio.h>
#include <string.h>

typedef struct { char c; const char *rows[16]; } Glyph;

/* Khung 8×16: thân chữ nằm ở hàng 2..13, rộng cột 1..6 (chừa khoảng cách). */
static const Glyph G[] = {
{' ',{"........","........","........","........","........","........","........","........","........","........","........","........","........","........","........","........"}},
{'!',{"........","........","...##...","...##...","...##...","...##...","...##...","...##...","...##...","........","...##...","...##...","........","........","........","........"}},
{'\'',{"........","...##...","...##...","...##...","........","........","........","........","........","........","........","........","........","........","........","........"}},
{'(',{"........","....##..","...##...","..##....","..##....","..##....","..##....","..##....","..##....","...##...","....##..","........","........","........","........","........"}},
{')',{"........","..##....","...##...","....##..","....##..","....##..","....##..","....##..","....##..","...##...","..##....","........","........","........","........","........"}},
{'+',{"........","........","........","...##...","...##...",".######.",".######.","...##...","...##...","........","........","........","........","........","........","........"}},
{',',{"........","........","........","........","........","........","........","........","........","........","...##...","...##...","..##....","........","........","........"}},
{'-',{"........","........","........","........","........","........",".######.",".######.","........","........","........","........","........","........","........","........"}},
{'.',{"........","........","........","........","........","........","........","........","........","........","...##...","...##...","........","........","........","........"}},
{'/',{"........","......##","......##",".....##.",".....##.","....##..","....##..","...##...","...##...","..##....","..##....",".##.....",".##.....","........","........","........"}},
{':',{"........","........","........","...##...","...##...","........","........","........","...##...","...##...","........","........","........","........","........","........"}},
{'?',{"........","..####..",".##..##.",".##..##.","....##..","...##...","...##...","...##...","........","...##...","...##...","........","........","........","........","........"}},
{'0',{"........","..####..",".##..##.",".##..##.",".##.###.",".##.###.",".###.##.",".###.##.",".##..##.",".##..##.","..####..","........","........","........","........","........"}},
{'1',{"........","...##...","..###...",".####...","...##...","...##...","...##...","...##...","...##...","...##...",".######.","........","........","........","........","........"}},
{'2',{"........","..####..",".##..##.","....###.","....##..","...##...","..##....",".##.....",".##.....",".##..##.",".######.","........","........","........","........","........"}},
{'3',{"........",".#####..","....###.","....##..","...###..","....###.","......##","......##",".##..##.",".##..##.","..####..","........","........","........","........","........"}},
{'4',{"........","....###.","...####.","..##.##.",".##..##.",".##..##.",".######.",".######.",".....##.",".....##.",".....##.","........","........","........","........","........"}},
{'5',{"........",".######.",".##.....",".##.....",".#####..","......##","......##","......##",".##..##.",".##..##.","..####..","........","........","........","........","........"}},
{'6',{"........","..####..",".##..##.",".##.....",".#####..",".##..##.",".##..##.",".##..##.",".##..##.",".##..##.","..####..","........","........","........","........","........"}},
{'7',{"........",".######.","......##",".....##.","....##..","....##..","...##...","...##...","..##....","..##....","..##....","........","........","........","........","........"}},
{'8',{"........","..####..",".##..##.",".##..##.",".##..##.","..####..",".##..##.",".##..##.",".##..##.",".##..##.","..####..","........","........","........","........","........"}},
{'9',{"........","..####..",".##..##.",".##..##.",".##..##.",".##..##.","..#####.","......##","......##",".##..##.","..####..","........","........","........","........","........"}},
{'A',{"........","...##...","..####..",".##..##.",".##..##.",".##..##.",".######.",".######.",".##..##.",".##..##.",".##..##.","........","........","........","........","........"}},
{'B',{"........",".#####..",".##..##.",".##..##.",".##..##.",".#####..",".##..##.",".##..##.",".##..##.",".##..##.",".#####..","........","........","........","........","........"}},
{'C',{"........","..####..",".##..##.",".##..##.",".##.....",".##.....",".##.....",".##.....",".##..##.",".##..##.","..####..","........","........","........","........","........"}},
{'D',{"........",".####...",".##.##..",".##..##.",".##..##.",".##..##.",".##..##.",".##..##.",".##..##.",".##.##..",".####...","........","........","........","........","........"}},
{'E',{"........",".######.",".##.....",".##.....",".##.....",".#####..",".##.....",".##.....",".##.....",".##.....",".######.","........","........","........","........","........"}},
{'F',{"........",".######.",".##.....",".##.....",".##.....",".#####..",".##.....",".##.....",".##.....",".##.....",".##.....","........","........","........","........","........"}},
{'G',{"........","..####..",".##..##.",".##.....",".##.....",".##.###.",".##..##.",".##..##.",".##..##.",".##..##.","..####..","........","........","........","........","........"}},
{'H',{"........",".##..##.",".##..##.",".##..##.",".##..##.",".######.",".##..##.",".##..##.",".##..##.",".##..##.",".##..##.","........","........","........","........","........"}},
{'I',{"........",".######.","...##...","...##...","...##...","...##...","...##...","...##...","...##...","...##...",".######.","........","........","........","........","........"}},
{'J',{"........","...#####","......##","......##","......##","......##","......##",".##..##.",".##..##.",".##..##.","..####..","........","........","........","........","........"}},
{'K',{"........",".##..##.",".##.##..",".##.##..",".####...",".###....",".####...",".##.##..",".##.##..",".##..##.",".##..##.","........","........","........","........","........"}},
{'L',{"........",".##.....",".##.....",".##.....",".##.....",".##.....",".##.....",".##.....",".##.....",".##.....",".######.","........","........","........","........","........"}},
{'M',{"........",".##..##.",".######.",".######.",".######.",".##.###.",".##..##.",".##..##.",".##..##.",".##..##.",".##..##.","........","........","........","........","........"}},
{'N',{"........",".##..##.",".###.##.",".###.##.",".####.#.",".##.###.",".##.###.",".##..##.",".##..##.",".##..##.",".##..##.","........","........","........","........","........"}},
{'O',{"........","..####..",".##..##.",".##..##.",".##..##.",".##..##.",".##..##.",".##..##.",".##..##.",".##..##.","..####..","........","........","........","........","........"}},
{'P',{"........",".#####..",".##..##.",".##..##.",".##..##.",".#####..",".##.....",".##.....",".##.....",".##.....",".##.....","........","........","........","........","........"}},
{'Q',{"........","..####..",".##..##.",".##..##.",".##..##.",".##..##.",".##..##.",".##.###.",".##.##..","..####..","....###.","........","........","........","........","........"}},
{'R',{"........",".#####..",".##..##.",".##..##.",".##..##.",".#####..",".####...",".##.##..",".##.##..",".##..##.",".##..##.","........","........","........","........","........"}},
{'S',{"........","..####..",".##..##.",".##.....",".##.....","..####..","......##","......##",".##..##.",".##..##.","..####..","........","........","........","........","........"}},
{'T',{"........",".######.","...##...","...##...","...##...","...##...","...##...","...##...","...##...","...##...","...##...","........","........","........","........","........"}},
{'U',{"........",".##..##.",".##..##.",".##..##.",".##..##.",".##..##.",".##..##.",".##..##.",".##..##.",".##..##.","..####..","........","........","........","........","........"}},
{'V',{"........",".##..##.",".##..##.",".##..##.",".##..##.",".##..##.",".##..##.","..####..","..####..","...##...","...##...","........","........","........","........","........"}},
{'W',{"........",".##..##.",".##..##.",".##..##.",".##.###.",".######.",".######.",".######.",".###.##.",".##..##.",".##..##.","........","........","........","........","........"}},
{'X',{"........",".##..##.",".##..##.","..####..","..####..","...##...","..####..","..####..",".##..##.",".##..##.",".##..##.","........","........","........","........","........"}},
{'Y',{"........",".##..##.",".##..##.",".##..##.","..####..","...##...","...##...","...##...","...##...","...##...","...##...","........","........","........","........","........"}},
{'Z',{"........",".######.","......##",".....##.","....##..","...##...","..##....",".##.....",".##.....",".##.....",".######.","........","........","........","........","........"}},
};

int main(void) {
    unsigned char font[96][16];
    memset(font, 0, sizeof(font));
    for (unsigned k = 0; k < sizeof(G)/sizeof(G[0]); k++) {
        int idx = (unsigned char)G[k].c - 0x20;
        if (idx < 0 || idx >= 96) continue;
        for (int r = 0; r < 16; r++) {
            const char *s = G[k].rows[r];
            unsigned char b = 0;
            for (int col = 0; col < 8 && s[col]; col++)
                if (s[col] == '#') b |= (unsigned char)(0x80u >> col);
            font[idx][r] = b;
        }
    }
    printf("#include \"font8x16.h\"\n\n");
    printf("/* SINH TỰ ĐỘNG bởi tools/genfont.c — KHÔNG sửa tay. */\n");
    printf("const uint8_t FONT8X16[96][16] = {\n");
    for (int i = 0; i < 96; i++) {
        printf("  { ");
        for (int r = 0; r < 16; r++) printf("0x%02X,", font[i][r]);
        printf(" }, /* 0x%02X '%c' */\n", i + 0x20, (i+0x20>=0x20&&i+0x20<0x7F)?(i+0x20):' ');
    }
    printf("};\n");
    return 0;
}
